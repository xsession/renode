## CMakeLists.txt
```
cmake_minimum_required(VERSION 3.20.0)
find_package(Zephyr REQUIRED HINTS $ENV{ZEPHYR_BASE})
project(stm32l476_zephyr_debug_lab)

target_sources(app PRIVATE
  src/main.c
  src/app_trace.c
  src/gpio_demo.c
  src/pwm_demo.c
  src/can_demo.c
  src/fault_injection.c
)
```

## west.yml
```
manifest:
  remotes:
    - name: zephyrproject-rtos
      url-base: https://github.com/zephyrproject-rtos
  projects:
    - name: zephyr
      remote: zephyrproject-rtos
      revision: main
      import:
        name-allowlist:
          - cmsis
          - hal_stm32
          - mbedtls
          - segger
  self:
    path: stm32l476-zephyr-debug-lab/app
```

## prj.conf
```kconfig
# Core logging and shell/debug visibility
CONFIG_LOG=y
CONFIG_LOG_MODE_IMMEDIATE=y
CONFIG_PRINTK=y
CONFIG_ASSERT=y
CONFIG_THREAD_NAME=y
CONFIG_INIT_STACKS=y
CONFIG_STACK_SENTINEL=y

# Useful for debugging stack and timing problems
CONFIG_THREAD_MONITOR=y
CONFIG_THREAD_RUNTIME_STATS=y

# GPIO / PWM / CAN
CONFIG_GPIO=y
CONFIG_PWM=y
CONFIG_CAN=y
CONFIG_CAN_LOOPBACK_MODE=y

# Console and RTT options. UART console is default on many Nucleo boards.
CONFIG_SERIAL=y
CONFIG_CONSOLE=y
CONFIG_UART_CONSOLE=y

# Optional: enable RTT if your setup supports it.
# CONFIG_USE_SEGGER_RTT=y
# CONFIG_RTT_CONSOLE=y

# Main stack size for debug-friendly printf/logging paths
CONFIG_MAIN_STACK_SIZE=4096
CONFIG_SYSTEM_WORKQUEUE_STACK_SIZE=2048

# Keep debug info useful
CONFIG_DEBUG=y
CONFIG_DEBUG_INFO=y
CONFIG_NO_OPTIMIZATIONS=y
```

## boards/nucleo_l476rg.overlay
```dts
/*
 * Teaching overlay.
 *
 * This overlay gives the application stable aliases/chosen nodes where possible.
 * Verify pin mappings against your board schematic and Zephyr's current
 * nucleo_l476rg devicetree before using external wiring.
 */

/ {
    aliases {
        /* Most Zephyr boards already define led0 and sw0. */
        /* pwm-led0 may require enabling a real timer PWM channel below. */
        pwm-led0 = &pwm_led0;
    };
};

/* Example PWM LED node. Adjust pwms target/channel/polarity for your board. */
pwmleds {
    compatible = "pwm-leds";
    pwm_led0: pwm_led0 {
        /* This is intentionally a placeholder-like teaching mapping. */
        pwms = <&pwm2 1 1000000 PWM_POLARITY_NORMAL>;
    };
};

/* Enable PWM on TIM2 if available in current Zephyr STM32L476 DTS. */
&pwm2 {
    status = "okay";
};

/* CAN device availability depends on current Zephyr board DTS and pinctrl. */
&can1 {
    status = "okay";
};
```

## src/main.c
```c
#include "app_trace.h"
#include "gpio_demo.h"
#include "pwm_demo.h"
#include "can_demo.h"
#include "fault_injection.h"

#include <zephyr/kernel.h>

#define HEARTBEAT_PERIOD K_MSEC(500)
#define PWM_PERIOD       K_MSEC(250)
#define CAN_PERIOD       K_MSEC(1000)

int main(void)
{
    app_trace_boot_banner();
    TRACE_EVENT("BOOT", "main entered");

    int ret;

    ret = gpio_demo_init();
    if (ret != 0) {
        TRACE_EVENT("BOOT", "gpio init failed ret=%d", ret);
    }

    ret = pwm_demo_init();
    if (ret != 0) {
        TRACE_EVENT("BOOT", "pwm init failed ret=%d", ret);
    }

    ret = can_demo_init();
    if (ret != 0) {
        TRACE_EVENT("BOOT", "can init failed ret=%d", ret);
    }

    fault_injection_init();

    int64_t next_heartbeat = k_uptime_get() + 500;
    int64_t next_pwm = k_uptime_get() + 250;
    int64_t next_can = k_uptime_get() + 1000;

    while (1) {
        int64_t now = k_uptime_get();

        if (now >= next_heartbeat) {
            next_heartbeat += 500;
            gpio_demo_tick();
        }

        if (now >= next_pwm) {
            next_pwm += 250;
            pwm_demo_tick();
        }

        if (now >= next_can) {
            next_can += 1000;
            can_demo_tick(
                pwm_demo_get_duty_percent(),
                gpio_demo_get_button_irq_count(),
                gpio_demo_get_led_state());
        }

        fault_injection_tick();
        k_sleep(K_MSEC(10));
    }

    return 0;
}
```

## src/app_trace.c
```c
#include "app_trace.h"

#include <zephyr/kernel.h>
#include <zephyr/sys/printk.h>

#include <stdarg.h>
#include <stdio.h>

void app_trace_boot_banner(void)
{
    printk("\n");
    printk("============================================================\n");
    printk(" STM32L476 Zephyr Debug Lab\n");
    printk(" GPIO + PWM + CAN + OpenOCD + Renode trace workflow\n");
    printk("============================================================\n");
}

void app_trace_event(const char *module, const char *fmt, ...)
{
    char buf[192];
    va_list args;

    va_start(args, fmt);
    vsnprintk(buf, sizeof(buf), fmt, args);
    va_end(args);

    printk("[%010lld ms] %-8s %s\n", k_uptime_get(), module, buf);
}
```

## src/app_trace.h
```c
#pragma once

#include <stdint.h>

void app_trace_boot_banner(void);
void app_trace_event(const char *module, const char *fmt, ...);

#define TRACE_EVENT(module, fmt, ...) \
    app_trace_event(module, fmt, ##__VA_ARGS__)
```

## src/can_demo.c
```c
#include "can_demo.h"
#include "app_trace.h"

#include <zephyr/kernel.h>
#include <zephyr/device.h>
#include <zephyr/drivers/can.h>
#include <zephyr/sys/byteorder.h>

/*
 * Default tries to find a CAN controller from a common devicetree alias.
 * If your board overlay names it differently, set zephyr,canbus chosen node or
 * adapt CAN_DEV_NODE below.
 */
#if DT_NODE_HAS_STATUS(DT_CHOSEN(zephyr_canbus), okay)
#define CAN_DEV_NODE DT_CHOSEN(zephyr_canbus)
#elif DT_NODE_HAS_STATUS(DT_ALIAS(can0), okay)
#define CAN_DEV_NODE DT_ALIAS(can0)
#else
#define CAN_DEV_NODE DT_INVALID_NODE
#endif

#if DT_NODE_HAS_STATUS(CAN_DEV_NODE, okay)
static const struct device *const can_dev = DEVICE_DT_GET(CAN_DEV_NODE);
#else
static const struct device *const can_dev = NULL;
#endif

static struct k_work_delayable can_rx_rearm_work;
static int rx_filter_id = -1;

static void can_rx_callback(const struct device *dev, struct can_frame *frame, void *user_data)
{
    ARG_UNUSED(dev);
    ARG_UNUSED(user_data);

    TRACE_EVENT("CAN", "RX id=0x%03x dlc=%u data=%02x %02x %02x %02x %02x %02x %02x %02x",
                frame->id, frame->dlc,
                frame->data[0], frame->data[1], frame->data[2], frame->data[3],
                frame->data[4], frame->data[5], frame->data[6], frame->data[7]);
}

static void can_rx_rearm_handler(struct k_work *work)
{
    ARG_UNUSED(work);
    /* Reserved for future advanced exercises. */
}

int can_demo_init(void)
{
    k_work_init_delayable(&can_rx_rearm_work, can_rx_rearm_handler);

    if (can_dev == NULL) {
        TRACE_EVENT("CAN", "no CAN device in devicetree; running CAN demo in log-only mode");
        return 0;
    }

    if (!device_is_ready(can_dev)) {
        TRACE_EVENT("CAN", "device not ready");
        return -ENODEV;
    }

#ifdef CONFIG_CAN_LOOPBACK_MODE
    int ret = can_set_mode(can_dev, CAN_MODE_LOOPBACK);
    if (ret != 0) {
        TRACE_EVENT("CAN", "loopback mode failed ret=%d; continue anyway", ret);
    } else {
        TRACE_EVENT("CAN", "loopback mode enabled");
    }
#endif

    struct can_filter filter = {
        .flags = 0U,
        .id = 0x123,
        .mask = CAN_STD_ID_MASK,
    };

    rx_filter_id = can_add_rx_filter(can_dev, can_rx_callback, NULL, &filter);
    if (rx_filter_id < 0) {
        TRACE_EVENT("CAN", "rx filter failed ret=%d", rx_filter_id);
        return rx_filter_id;
    }

    int ret = can_start(can_dev);
    if (ret != 0) {
        TRACE_EVENT("CAN", "start failed ret=%d", ret);
        return ret;
    }

    TRACE_EVENT("CAN", "initialized filter=%d", rx_filter_id);
    return 0;
}

void can_demo_tick(uint8_t duty_percent, uint32_t button_count, int led_state)
{
    struct can_frame frame = {0};

    frame.id = 0x123;
    frame.dlc = 8;
    frame.data[0] = 0xA5;
    frame.data[1] = duty_percent;
    frame.data[2] = (uint8_t)(button_count & 0xFFU);
    frame.data[3] = led_state ? 1U : 0U;
    frame.data[4] = 0x11;
    frame.data[5] = 0x22;
    frame.data[6] = 0x33;
    frame.data[7] = 0x44;

    if (can_dev == NULL || !device_is_ready(can_dev)) {
        TRACE_EVENT("CAN", "TX simulated id=0x%03x duty=%u button=%u led=%d",
                    frame.id, duty_percent, button_count, led_state);
        return;
    }

    int ret = can_send(can_dev, &frame, K_MSEC(100), NULL, NULL);
    if (ret != 0) {
        TRACE_EVENT("CAN", "TX failed ret=%d id=0x%03x", ret, frame.id);
    } else {
        TRACE_EVENT("CAN", "TX id=0x%03x duty=%u button=%u led=%d",
                    frame.id, duty_percent, button_count, led_state);
    }
}
```

## src/can_demo.h
```c
#pragma once

#include <stdint.h>

int can_demo_init(void);
void can_demo_tick(uint8_t duty_percent, uint32_t button_count, int led_state);
```

## src/fault_injection.c
```c
#include "fault_injection.h"
#include "app_trace.h"

#include <zephyr/kernel.h>

/*
 * GDB-callable hooks for laboratory exercises.
 * Example in GDB:
 *   call debug_force_trace_marker()
 *   call debug_simulate_button_event()
 */

void debug_force_trace_marker(void)
{
    TRACE_EVENT("DBG", "manual trace marker from GDB");
}

void debug_simulate_button_event(void)
{
    TRACE_EVENT("DBG", "software-injected button event placeholder");
}

void debug_halt_here(void)
{
    TRACE_EVENT("DBG", "breakpoint hook entered");
}

void fault_injection_init(void)
{
    TRACE_EVENT("DBG", "fault injection hooks ready");
}

void fault_injection_tick(void)
{
    /* Intentionally empty. Students add exercises here. */
}
```

## src/fault_injection.h
```c
#pragma once

void fault_injection_init(void);
void fault_injection_tick(void);
```

## src/gpio_demo.c
```c
#include "gpio_demo.h"
#include "app_trace.h"

#include <zephyr/kernel.h>
#include <zephyr/device.h>
#include <zephyr/drivers/gpio.h>

#define LED0_NODE DT_ALIAS(led0)
#define SW0_NODE  DT_ALIAS(sw0)

#if !DT_NODE_HAS_STATUS(LED0_NODE, okay)
#error "Unsupported board: led0 devicetree alias is not defined"
#endif

static const struct gpio_dt_spec led = GPIO_DT_SPEC_GET(LED0_NODE, gpios);

#if DT_NODE_HAS_STATUS(SW0_NODE, okay)
static const struct gpio_dt_spec button = GPIO_DT_SPEC_GET(SW0_NODE, gpios);
static struct gpio_callback button_cb_data;
#endif

static volatile uint32_t button_irq_count;
static int led_state;

#if DT_NODE_HAS_STATUS(SW0_NODE, okay)
static void button_pressed(const struct device *dev, struct gpio_callback *cb, uint32_t pins)
{
    ARG_UNUSED(dev);
    ARG_UNUSED(cb);
    ARG_UNUSED(pins);

    button_irq_count++;
    TRACE_EVENT("GPIO", "button IRQ count=%u", button_irq_count);
}
#endif

int gpio_demo_init(void)
{
    int ret;

    if (!gpio_is_ready_dt(&led)) {
        TRACE_EVENT("GPIO", "LED device not ready");
        return -ENODEV;
    }

    ret = gpio_pin_configure_dt(&led, GPIO_OUTPUT_INACTIVE);
    if (ret < 0) {
        TRACE_EVENT("GPIO", "LED configure failed ret=%d", ret);
        return ret;
    }

#if DT_NODE_HAS_STATUS(SW0_NODE, okay)
    if (!gpio_is_ready_dt(&button)) {
        TRACE_EVENT("GPIO", "button device not ready");
        return -ENODEV;
    }

    ret = gpio_pin_configure_dt(&button, GPIO_INPUT);
    if (ret < 0) {
        TRACE_EVENT("GPIO", "button configure failed ret=%d", ret);
        return ret;
    }

    ret = gpio_pin_interrupt_configure_dt(&button, GPIO_INT_EDGE_TO_ACTIVE);
    if (ret < 0) {
        TRACE_EVENT("GPIO", "button interrupt configure failed ret=%d", ret);
        return ret;
    }

    gpio_init_callback(&button_cb_data, button_pressed, BIT(button.pin));
    gpio_add_callback(button.port, &button_cb_data);
#endif

    TRACE_EVENT("GPIO", "initialized LED pin=%u", led.pin);
    return 0;
}

void gpio_demo_tick(void)
{
    led_state = !led_state;
    gpio_pin_set_dt(&led, led_state);
    TRACE_EVENT("GPIO", "heartbeat led=%d button_irq_count=%u", led_state, button_irq_count);
}

uint32_t gpio_demo_get_button_irq_count(void)
{
    return button_irq_count;
}

int gpio_demo_get_led_state(void)
{
    return led_state;
}
```

## src/gpio_demo.h
```c
#pragma once

#include <stdint.h>

int gpio_demo_init(void);
void gpio_demo_tick(void);
uint32_t gpio_demo_get_button_irq_count(void);
int gpio_demo_get_led_state(void);
```

## src/pwm_demo.c
```c
#include "pwm_demo.h"
#include "app_trace.h"

#include <zephyr/kernel.h>
#include <zephyr/device.h>
#include <zephyr/drivers/pwm.h>

#define PWM_LED0_NODE DT_ALIAS(pwm_led0)

#if DT_NODE_HAS_STATUS(PWM_LED0_NODE, okay)
static const struct pwm_dt_spec pwm_led = PWM_DT_SPEC_GET(PWM_LED0_NODE);
#endif

static uint8_t duty_percent = 10;
static const uint32_t pwm_period_ns = 1000000U; /* 1 kHz */

static int pwm_apply(uint8_t duty)
{
#if DT_NODE_HAS_STATUS(PWM_LED0_NODE, okay)
    uint32_t pulse_ns = (pwm_period_ns * duty) / 100U;
    int ret = pwm_set_dt(&pwm_led, pwm_period_ns, pulse_ns);
    if (ret < 0) {
        TRACE_EVENT("PWM", "set failed ret=%d", ret);
    }
    return ret;
#else
    TRACE_EVENT("PWM", "pwm_led0 alias missing; simulated duty=%u", duty);
    return 0;
#endif
}

int pwm_demo_init(void)
{
#if DT_NODE_HAS_STATUS(PWM_LED0_NODE, okay)
    if (!pwm_is_ready_dt(&pwm_led)) {
        TRACE_EVENT("PWM", "device not ready");
        return -ENODEV;
    }
#endif

    int ret = pwm_apply(duty_percent);
    TRACE_EVENT("PWM", "initialized period_ns=%u duty=%u", pwm_period_ns, duty_percent);
    return ret;
}

void pwm_demo_tick(void)
{
    duty_percent += 10;
    if (duty_percent > 90) {
        duty_percent = 10;
    }

    pwm_apply(duty_percent);
    TRACE_EVENT("PWM", "duty=%u%%", duty_percent);
}

uint8_t pwm_demo_get_duty_percent(void)
{
    return duty_percent;
}
```

## src/pwm_demo.h
```c
#pragma once

#include <stdint.h>

int pwm_demo_init(void);
void pwm_demo_tick(void);
uint8_t pwm_demo_get_duty_percent(void);
```
